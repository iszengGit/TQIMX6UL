## uboot-imx/arch/arm/cpu/armv7/mx6/Kconfig
```kconfig
if ARCH_MX6

config MX6
	bool
	default y

config MX6D
	bool

config MX6DL
	bool

config MX6Q
	bool

config MX6QDL
	bool

config MX6S
	bool

config MX6SL
	bool

config MX6SX
	select ROM_UNIFIED_SECTIONS
	bool

config MX6SLL
	select ROM_UNIFIED_SECTIONS
	bool

config MX6UL
	select SYS_L2CACHE_OFF
	select ROM_UNIFIED_SECTIONS
	bool

config MX6ULL
	bool
	select MX6UL

choice
	prompt "MX6 board select"
	optional

config TARGET_ARISTAINETOS
	bool "aristainetos"

config TARGET_ARISTAINETOS2
	bool "aristainetos2"

config TARGET_ARISTAINETOS2B
	bool "Support aristainetos2-revB"

config TARGET_CGTQMX6EVAL
	bool "cgtqmx6eval"
	select SUPPORT_SPL
	select DM
	select DM_THERMAL

config TARGET_CM_FX6
	bool "CM-FX6"
	select SUPPORT_SPL
	select DM
	select DM_SERIAL
	select DM_GPIO

config TARGET_EMBESTMX6BOARDS
	bool "embestmx6boards"

config TARGET_GW_VENTANA
	bool "gw_ventana"
	select SUPPORT_SPL

config TARGET_KOSAGI_NOVENA
	bool "Kosagi Novena"
	select SUPPORT_SPL

config TARGET_MX6CUBOXI
	bool "Solid-run mx6 boards"
	select SUPPORT_SPL

config TARGET_MX6QARM2
	bool "mx6qarm2"
	select DM
	select DM_THERMAL

config TARGET_MX6QSABREAUTO
	bool "mx6qsabreauto"
	select DM
	select DM_THERMAL

config TARGET_MX6SABRESD
	bool "mx6sabresd"
	select SUPPORT_SPL
	select DM
	select DM_THERMAL

config TARGET_MX6SLEVK
	bool "mx6slevk"
	select SUPPORT_SPL
	select DM
	select DM_THERMAL

config TARGET_MX6SLLEVK
        bool "mx6sll evk"
        select MX6SLL
        select DM
        select DM_THERMAL

config TARGET_MX6SLL_ARM2
	bool "mx6sll arm2"
	select MX6SLL
	select DM
	select DM_THERMAL

config TARGET_MX6SXSABRESD
	bool "mx6sxsabresd"
	select MX6SX
	select SUPPORT_SPL
	select DM
	select DM_THERMAL

config TARGET_MX6SXSABREAUTO
        bool "mx6sxsabreauto"
	select MX6SX
        select DM
        select DM_THERMAL

config TARGET_MX6UL_9X9_EVK
	bool "mx6ul_9x9_evk"
	select MX6UL
	select DM
	select DM_THERMAL
	select SUPPORT_SPL

config TARGET_MX6UL_14X14_EVK
	bool "mx6ul_14x14_evk"
	select MX6UL
	select DM
	select DM_THERMAL
	select SUPPORT_SPL

config TARGET_MX6UL_14X14_DDR3_ARM2
	bool "mx6ul_14x14_ddr3_arm2"
	select MX6UL
	select DM
	select DM_THERMAL

config TARGET_MX6UL_14X14_LPDDR2_ARM2
	bool "mx6ul_14x14_lpddr2_arm2"
	select MX6UL
	select DM
	select DM_THERMAL

config TARGET_MX6SX_17X17_ARM2
	bool "mx6sx_17x17_arm2"
	select MX6SX
	select DM
	select DM_THERMAL

config TARGET_MX6SX_19X19_ARM2
	bool "mx6sx_19x19_arm2"
	select MX6SX
	select DM
	select DM_THERMAL

config TARGET_PICOSOM_IMX6UL
        bool "Support picosom-imx6ul"
	select MX6UL
	select DM
	select DM_THERMAL

config TARGET_NITROGEN6X
	bool "nitrogen6x"

config TARGET_OT1200
	bool "Bachmann OT1200"
	select SUPPORT_SPL

config TARGET_PLATINUM_PICON
	bool "platinum-picon"
	select SUPPORT_SPL

config TARGET_PLATINUM_TITANIUM
	bool "platinum-titanium"
	select SUPPORT_SPL

config TARGET_MX6ULL_DDR3_ARM2
	bool "Support mx6ull_ddr3_arm2"
	select MX6ULL
	select DM
	select DM_THERMAL

config TARGET_MX6ULL_14X14_EVK
	bool "Support mx6ull_14x14_evk"
	select MX6ULL
	select DM
	select DM_THERMAL

config TARGET_MX6ULL_9X9_EVK
	bool "Support mx6ull_9x9_evk"
	select MX6ULL
	select DM
	select DM_THERMAL

config TARGET_TQIMX6ULL_COREB
	bool "Support support tq imx6ull core_b"
	select MX6ULL
	select DM
	select DM_THERMAL

config TARGET_TQIMX6UL_COREB
	bool "Support support tq imx6ul core_b"
	select MX6UL
	select DM
	select DM_THERMAL

config TARGET_SECOMX6
	bool "secomx6 boards"

config TARGET_TBS2910
	bool "TBS2910 Matrix ARM mini PC"

config TARGET_TITANIUM
	bool "titanium"

config TARGET_TQMA6
	bool "TQ Systems TQMa6 board"

config TARGET_UDOO
	bool "udoo"
	select SUPPORT_SPL

config TARGET_WANDBOARD
	bool "wandboard"
	select SUPPORT_SPL

config TARGET_WARP
	bool "WaRP"

config TARGET_MX6DQSCM
	bool "mx6dqscm"
	select DM
	select DM_THERMAL

config TARGET_MX6SXSCM
        bool "mx6sxscm"
        select MX6SX
        select DM
        select DM_THERMAL

endchoice

config SYS_SOC
	default "mx6"

#source "board/EmbedSky/tq-imx6ull/Kconfig"
#source "board/EmbedSky/tq-imx6ul/Kconfig"

endif
```

## uboot-imx/board/EmbedSky/tq-imx6ul/Kconfig
```kconfig
if TARGET_TQIMX6UL_COREB

config SYS_BOARD
	default "tq-imx6ul"

config SYS_VENDOR
	default "EmbedSky"

config SYS_CONFIG_NAME
	default "tq-imx6ul"

endif
```

## uboot-imx/board/EmbedSky/tq-imx6ull/Kconfig
```kconfig
if TARGET_TQIMX6ULL_COREB

config SYS_BOARD
	default "tq-imx6ull"

config SYS_VENDOR
	default "EmbedSky"

config SYS_CONFIG_NAME
	default "tq-imx6ull"

endif
```

## uboot-imx/configs/tq-imx6ul_defconfig
```kconfig
CONFIG_SYS_EXTRA_OPTIONS="IMX_CONFIG=board/EmbedSky/tq-imx6ul/imximage.cfg"
CONFIG_ARM=y
CONFIG_ARCH_MX6=y
CONFIG_TQIMX6UL=y
#CONFIG_TARGET_MX6ULL_14X14_EVK=y
CONFIG_TARGET_TQIMX6UL_COREB=y
CONFIG_SYS_PROMPT="TQIMX6UL => "

CONFIG_CMD_GPIO=y
```

## uboot-imx/configs/tq-imx6ull_defconfig
```kconfig
CONFIG_SYS_EXTRA_OPTIONS="IMX_CONFIG=board/EmbedSky/tq-imx6ull/imximage.cfg"
CONFIG_ARM=y
CONFIG_ARCH_MX6=y
CONFIG_TQIMX6UL
#CONFIG_TARGET_MX6ULL_14X14_EVK=y
CONFIG_TARGET_TQIMX6ULL_COREB=y
CONFIG_SYS_PROMPT="TQIMX6ULL => "

CONFIG_CMD_GPIO=y
```
